## drivers/input/oplus_fp_drivers/Kconfig
```kconfig
menuconfig OPPO_FINGERPRINT
	bool "OPPO fingerprint"
	depends on SPI_MASTER
	help
	  Say Y here to enable OPPO fingerprint support

if OPPO_FINGERPRINT
### fingerprint common config
config OPPO_FINGERPRINT_COMMON
       default n
       tristate "Fingerprint common"

### platform config
config OPPO_FINGERPRINT_QCOM
       default n
       tristate "Fingerprint base on QCOM"

config OPPO_FINGERPRINT_MTK
       default n
       tristate "Fingerprint base on MTK"

### fingerprint sensor config
config OPPO_FINGERPRINT_FPC
       default n
       tristate "Fingerprint base on fpc capacitive chip"
config OPPO_FINGERPRINT_GOODIX
       default n
       tristate "Fingerprint base on goodix capacitive chip"
config OPPO_FINGERPRINT_GOODIX_OPTICAL
       default n
       tristate "Fingerprint base on goodix optical chip"
config OPPO_FINGERPRINT_SILEAD_OPTICAL
       default n
       tristate "Fingerprint base on silead optical chip"
config OPPO_FINGERPRINT_EGIS_OPTICAL
       default n
       tristate "Fingerprint base on egis optical chip"

### fingerprint feature config
config OPPO_FINGERPRINT_NAVIGATION_ENABLE
       default n
       tristate "Fingerprint navigation function"

endif #OPPO_FINGERPRINT
```

## drivers/input/touchscreen/oplus_touchscreen_v2/Focal/ft3518/Kconfig
```kconfig
config TOUCHPANEL_FOCAL_FT3518
	tristate "TP focal ft3518 IC enable or not for OPLUS"
	---help---
	say Y to enable driver for Touchpanel using Focal FT3518
```

## drivers/input/touchscreen/oplus_touchscreen_v2/Samsung/S6SY792/Kconfig
```kconfig
#ifdef VENDOR_EDIT
#Added by Cong.Dai@Bsp.group.Tp for Samsung s6sy791 ic driver

config TOUCHPANEL_SAMSUNG_S6SY792
#   default y
    tristate "TP Samsung s6sy792 IC enable or not for OPLUS"
    ---help---
    say Y to enable driver for Touchpanel using Samsung s6sy792

#endif
```

## drivers/input/touchscreen/oplus_touchscreen_v2/ilitek/ilitek9881h/Kconfig
```kconfig
#ifdef OPLUS_FEATURE_TP_BASIC
#Added by guqicai@Bsp.group.Tp for ilitek ilitek9881h ic driver

config TOUCHPANEL_ILITEK_ILITEK9881H_V3
#	default y
	tristate "TP ilitek ilitek9881h IC enable or not for OPLUS"
	---help---
	say Y to enable driver for Touchpanel using ilitek ilitek9881h

#endif
```

## drivers/scsi/ufs/oplus_ufs/Kconfig
```kconfig
config OPLUS_FEATURE_UFS_DRIVER
  tristate "oplus ufs driver"
  help
    define this config to define oppo ufs driver common modify
```

## drivers/soc/Kconfig
```kconfig
# SPDX-License-Identifier: GPL-2.0-only
menu "SOC (System On Chip) specific Drivers"

source "drivers/soc/actions/Kconfig"
source "drivers/soc/amlogic/Kconfig"
source "drivers/soc/aspeed/Kconfig"
source "drivers/soc/atmel/Kconfig"
source "drivers/soc/bcm/Kconfig"
source "drivers/soc/fsl/Kconfig"
source "drivers/soc/imx/Kconfig"
source "drivers/soc/ixp4xx/Kconfig"
source "drivers/soc/mediatek/Kconfig"
source "drivers/soc/qcom/Kconfig"
source "drivers/soc/renesas/Kconfig"
source "drivers/soc/rockchip/Kconfig"
source "drivers/soc/samsung/Kconfig"
source "drivers/soc/sunxi/Kconfig"
source "drivers/soc/tegra/Kconfig"
source "drivers/soc/ti/Kconfig"
source "drivers/soc/ux500/Kconfig"
source "drivers/soc/versatile/Kconfig"
source "drivers/soc/xilinx/Kconfig"
source "drivers/soc/zte/Kconfig"
#ifdef OPLUS_FEATURE_POWERINFO_STANDBY
#Yunqing.Zeng@BSP.Power.Basic, 2020/09/10, add for feature powerinfo standby.
source "drivers/soc/oplus/oplus_wakelock/Kconfig"
#endif /* OPLUS_FEATURE_POWERINFO_STANDBY */
#ifdef VENDOR_EDIT
#wen.luo@BSP.Kernel.Stability 2020/03/25 add for oplus kernel system
source "drivers/soc/oplus/system/Kconfig"
#source "drivers/soc/oplus/device_info/Kconfig"
#endif /* VENDOR_EDIT */

#ifdef OPLUS_FEATURE_TP_BASIC
#Qicai.gu@BSP.TP.Init, 2020/08/05, Add for device_info for gki.
source "drivers/soc/oplus/device_info/Kconfig"
#endif /* OPLUS_FEATURE_TP_BASIC */

#ifdef OPLUS_FEATURE_SENSOR_SMEM
#qiuzuolin@BSP.Sensor.Basic 2020/07/31 add for oplus sensor smem
source "drivers/soc/oplus/sensor/Kconfig"
#endif /* OPLUS_FEATURE_SENSOR_SMEM */

#ifdef OPLUS_FEATURE_THERMAL_HORAE
source "drivers/soc/oplus/thermal/Kconfig"
#endif /* OPLUS_FEATURE_THERMAL_HORAE */

#ifdef OPLUS_FEATURE_ESIM
#ChenGuoyao@NETWORK.IMS 2020/11/02 add for oplus kernel misc
source "drivers/soc/oplus/misc/Kconfig"
#endif /* OPLUS_FEATURE_ESIM */

#ifdef OPLUS_FEATURE_HEALTHINFO
#Jiheng.Xie@BSP.Kernel.Performance 2020/06/18 add for oplus healthinfo
source "drivers/soc/oplus/healthinfo/Kconfig"
#endif /* OPLUS_FEATURE_HEALTHINFO */
endmenu

#ifdef OPLUS_FEATURE_MEMLEAK_DETECT
#Add for svelte
source "drivers/soc/oplus/svelte/Kconfig"
#endif /* OPLUS_FEATURE_MEMLEAK_DETECT */

#ifdef OPLUS_FEATURE_LOWMEM_DBG
source "drivers/soc/oplus/lowmem_dbg/Kconfig"
#endif /* OPLUS_FEATURE_LOWMEM_DBG */

#ifdef OPLUS_FEATURE_MIDAS_DEVICE
source "drivers/soc/oplus/midas/Kconfig"
#endif

#ifdef OPLUS_FEATURE_IM
#ted.lin@optimization add for im module
source "drivers/soc/oplus/im/Kconfig"
#endif /* OPLUS_FEATURE_IM */

#ifdef OPLUS_FEATURE_CPUFREQ_BOUNCING
source "drivers/soc/oplus/cpufreq_bouncing/Kconfig"
#endif

#ifdef OPLUS_FEATURE_TPD
source "drivers/soc/oplus/tpd/Kconfig"
#endif

#ifdef OPLUS_FEATURE_HOUSTON
source "drivers/soc/oplus/houston/Kconfig"
#endif

#Add for NandSwap
source "drivers/soc/oplus/oplus_nandswap/Kconfig"
```

## drivers/soc/oplus/device_info/Kconfig
```kconfig
config OPLUS_DEVICE_IFNO
  tristate "config oppo devinfo software"
  help
    define this config to compile devinfo.c for device register
```

## drivers/soc/oplus/healthinfo/Kconfig
```kconfig
#ifdef OPLUS_FEATURE_HEALTHINFO
#//wenbin.liu@PSW.Kernel.MM, 2018/05/23, Add for Healthinfo monitor
config OPLUS_HEALTHINFO
bool "config healthinfo"
help
    define this config to init  healthinfo.
#endif /* OPLUS_FEATURE_HEALTHINFO */
```

## drivers/soc/oplus/houston/Kconfig
```kconfig
config OPLUS_FEATURE_HOUSTON
	tristate "houston"
	default n
	help
	  kernel layer data center
```

## drivers/soc/oplus/midas/Kconfig
```kconfig
# SPDX-License-Identifier: GPL-2.0-only
# Copyright (C) 2018-2020 Oplus. All rights reserved.

config OPLUS_FEATURE_MIDAS
bool "config oplus midas feature"
help
	This selects midas driver

config OPLUS_FEATURE_MIDAS_DEVICE
bool "config oplus midas device feature"
help
	This selects midas device driver

config OPLUS_FEATURE_BINDER_STATS_ENABLE
bool "config oplus midas binder stats feature"
help
	This selects midas binder stats device driver
```

## drivers/soc/oplus/misc/Kconfig
```kconfig
# SPDX-License-Identifier: GPL-2.0-only
# Copyright (C) 2018-2020 Oplus. All rights reserved.

#ifdef OPLUS_FEATURE_ESIM
#ChenGuoyao@NETWORK.SIM,2020/06/10, Add for eSIM
source "drivers/soc/oplus/misc/oplus_gpio/Kconfig"
#endif /* OPLUS_FEATURE_ESIM */
```

## drivers/soc/oplus/sensor/Kconfig
```kconfig
config OPLUS_FEATURE_SENSOR_CFG
	tristate "oplus sensor share memory config"
	default y
	help
	  To compile this driver as a module, set M in kernel build config
config OPLUS_SENSOR_FB_QC
	tristate "sensor feedback config for qcom"
	help
	  To compile this driver as a module, set M in kernel build config
	  module will be called sensor_feedback.
```

## drivers/soc/oplus/system/Kconfig
```kconfig
# SPDX-License-Identifier: GPL-2.0-only
# Copyright (C) 2018-2020 Oplus. All rights reserved.
config OPLUS_SYSTEM_KERNEL
  bool "config oplus system feature "
  default y
  help
	define this config to add oplus sytstem kernel feature

config OPPO_ARCH_FILE
  bool "for build directory oppo"
  ---help---
  say Y to buid in

config OPPO_COMMON_SOFT
  bool "config oppo common software"
  select OPPO_ARCH_FILE
  help
	define this config to get project verion from sharemem.
	Maybe this value is from CDT or dynamic identify by hardware
	id.

config OPPO_DEVICE_IFNO
  bool "config oppo devinfo"
  select OPPO_ARCH_FILE
  help
	define this config to compile devinfo.c for device register
		.

config OPLUS_FEATURE_DETAILHEAD
  tristate "config detail kmsg"
  help
	define this config to add cpu number and current id and current comm to kmsg

config OPLUS_BUG_STABILITY_EFFECTON_QGKI
  tristate "config stability bug fixing effect on qgki"
  help
	define this config to fix stability bug only effect on qgki


source "drivers/soc/oplus/system/feedback/Kconfig"
source "drivers/soc/oplus/system/uboot_log/Kconfig"
source "drivers/soc/oplus/system/shutdown_detect/Kconfig"
source "drivers/soc/oplus/system/slabtrace/Kconfig"
source "drivers/soc/oplus/system/oplus_project/Kconfig"
source "drivers/soc/oplus/system/qcom_minidump/Kconfig"
source "drivers/soc/oplus/system/hung_task_enhance/Kconfig"
source "drivers/soc/oplus/system/oplus_phoenix/Kconfig"
source "drivers/soc/oplus/system/oplus_pmic_monitor/Kconfig"
source "drivers/soc/oplus/system/oplus_saupwk/Kconfig"
source "drivers/soc/oplus/system/project_info/Kconfig"
source "drivers/soc/oplus/system/cmdline_parser/Kconfig"
source "drivers/soc/oplus/system/dump_device_info/Kconfig"
source "drivers/soc/oplus/system/mdmrst/Kconfig"
#ifdef OPLUS_FEATURE_ESIM
#ChenGuoyao@NETWORK.SIM,2020/06/10, Add for eSIM
source "drivers/soc/oplus/system/oppo_gpio/Kconfig"
#endif /* OPLUS_FEATURE_ESIM */
#ifdef OPLUS_FEATURE_QCOM_PMICWD
#ZhangFei@BSP.Kernel.Stability, 2020/04/03, Add for qcom pmic watchdog
source "drivers/soc/oplus/system/qcom_pmicwd/Kconfig"
#endif /* OPLUS_FEATURE_QCOM_PMICWD */

#ifdef OPLUS_FEATURE_DUMP_REASON
#terry.zhong@optimization.Stability, 2020/11/30, Add for dump reason
source "drivers/soc/oplus/system/dump_reason/Kconfig"
#endif /* OPLUS_FEATURE_DUMP_REASON */

#ifdef OPLUS_FEATURE_MM_FEEDBACK
#Zhao.Pan@MULTIMEDIA.AUDIODRIVER.KERNEL, 2020/08/08, Add for multimedia kevent feedback driver
source "drivers/soc/oplus/system/oplus_mm_fb/Kconfig"
#endif /* OPLUS_FEATURE_MM_FEEDBACK */

#ifdef OPLUS_FEATURE_QCOM_WATCHDOG
#yanghao@BSP.Kernel.Stability, 2020/04/03, Add for qcom pmic watchdog
source "drivers/soc/oplus/system/qcom_watchdog/Kconfig"
#endif /* OPLUS_FEATURE_QCOM_WATCHDOG */

#ifdef OPLUS_FEATURE_ACM
#Yuwei.Guan@BSP.Kernel.FS,2020/07/08, Add for acm
source "drivers/soc/oplus/system/acm/Kconfig"
#endif /* OPLUS_FEATURE_ACM */
#ifdef OPLUS_FEATURE_THEIA
#yanggang@BSP.Kernel.Stability,2020/07/08, Add for theia
source "drivers/soc/oplus/system/theia/Kconfig"
#endif /* OPLUS_FEATURE_THEIA */
#ifdef OPLUS_FEATURE_SELINUX_CONTROL_LOG
#Shuangquan.Du@ANDROID.SELINUX, 2018/01/13, Add for disable selinux denied logs in MP version
source "drivers/soc/oplus/system/selinux/Kconfig"
#endif /* OPLUS_FEATURE_SELINUX_CONTROL_LOG */
#ifdef OPLUS_FEATURE_MISC
#terry.zhong@OPTI.Kernel.Stability, 2020/09/7, enable oplus misc feature
source "drivers/soc/oplus/system/misc/Kconfig"
#endif /* OPLUS_FEATURE_MISC */
```

## drivers/soc/oplus/system/oplus_saupwk/Kconfig
```kconfig
# SPDX-License-Identifier: GPL-2.0-only
# Copyright (C) 2018-2020 Oplus. All rights reserved.
#Bin.Wen@TECH.BSP.Stability.SAUPWK 2020/06/15, Add for SAUPWK
#change 'y' to 'n', if you want fo close saupwk feature
config OPLUS_FEATURE_SAUPWK
    tristate "oplus saupwk project"
    default n
    help
      define this config to init oplus saupwk.
```

## fs/proc/healthinfo/Kconfig
```kconfig
#ifdef OPLUS_FEATURE_HEALTHINFO
#Huacai.Zhou@PSW.BSP.kernel.Peformance, 2018/06/18, add foreground process opt support
config FG_TASK_UID
	bool "Enable /proc/fg_info/ if EXPERT"
	default y
	help
	  Add foreground process optimize support to promote performance .
#endif
#ifdef OPLUS_FEATURE_HEALTHINFO
#Liujie.Xie@TECH.Kernel.Sched, 2020/05/20, add jank monitor opt support
config OPLUS_JANK_INFO
	bool "Enable /proc/pid/jank_info if EXPERT"
	default n
	help
	  Add jank monitor opt support .
#endif
```
