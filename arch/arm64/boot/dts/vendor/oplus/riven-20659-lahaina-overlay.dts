#include "../qcom/lahaina-mtp-overlay.dts"
//#include "lahaina_overlay_oplus_common.dtsi"
//#include "lahaina_overlay_oplus_common_pinctrl.dtsi"
#include "lahaina-camera-sensor-20659.dtsi"
#include "riven-common.dtsi"
#include "riven-20659.dtsi"
#include "nfc/riven-nfc-sn100t.dtsi"

/ {
	model = "Qualcomm Technologies, Inc. Lahaina MTP";
	compatible = "qcom,lahaina-mtp", "qcom,lahaina", "qcom,mtp";
	qcom,board-id = <0x10008 0>;
	oppo,dtsi_no = <20659>;
};
